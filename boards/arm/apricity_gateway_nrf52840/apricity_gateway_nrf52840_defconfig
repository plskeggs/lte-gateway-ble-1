## boards/arm/apricity_gateway_nrf52840/apricity_gateway_nrf52840_defconfig
```kconfig
CONFIG_SOC_SERIES_NRF52X=y
CONFIG_SOC_NRF52840_QIAA=y
CONFIG_BOARD_APRICITY_GATEWAY_NRF52840=y

# Enable MPU
CONFIG_ARM_MPU=y

# enable uart driver
CONFIG_SERIAL=y

# Enable console
CONFIG_CONSOLE=y

# Enable PINCTRL
CONFIG_PINCTRL=y

# Enable GPIO
CONFIG_GPIO=y

# Additional board options
CONFIG_GPIO_AS_PINRESET=y
```
